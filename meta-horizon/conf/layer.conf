## meta-horizon/conf/layer.conf
```bitbake
BBPATH .= ":${LAYERDIR}"

# We have recipes-* directories, add to BBFILES
BBFILES += "${LAYERDIR}/recipes-*/*/*.bb \
	    ${LAYERDIR}/recipes-*/*/*.bbappend"


BBFILE_COLLECTIONS += "horizon"
BBFILE_PATTERN_horizon := "^${LAYERDIR}/"

BBFILE_PRIORITY_horizon = "9"

HRBASE = '${@os.path.normpath("${LAYERDIR}")}'
BB_BASEHASH_IGNORE_VARS:append = " HRBASE"


LAYERSERIES_COMPAT_horizon = "scarthgap"
LAYERVERSION_horizon = "1.0"
LAYERDEPENDS_horizon = "core openembedded-layer"
```

## meta-horizon/conf/machine/horizon-x5-soc.conf
```bitbake
require conf/machine/include/arm/arch-armv8-2a.inc
require conf/machine/include/common.inc

PREFERRED_PROVIDER_virtual/kernel = "linux-horizon"
KERNEL_IMAGETYPE = "Image"
KBUILD_DEFCONFIG := "hobot_x5_soc_defconfig"

PREFERRED_PROVIDER_virtual/bootloader = "u-boot-horizon"
UBOOT_MACHINE = "hobot_x5_auto_defconfig"
```

## meta-horizon/conf/machine/include/common.inc
```bitbake
EXTERNAL_TOOLCHAIN = "/opt/arm-gnu-toolchain-11.3.rel1-x86_64-aarch64-none-linux-gnu"
TOOLCHAIN_PREFIX = "aarch64-none-linux-gnu-"

HR_SDK_DIR = "${TOPDIR}/../horizon-sdk"
HR_SDK_UBOOT_DIR = "${HR_SDK_DIR}/platform_source_code/uboot"
HR_SDK_MINIBOOT_DIR = "${HR_SDK_DIR}/platform_source_code/miniboot"

HR_BUILD_OUTPUT_DIR = "${TOPDIR}/../out"
HR_TARGET_DEPLOY_DIR = "${HR_BUILD_OUTPUT_DIR}/deploy"
HR_UBOOT_OUTPUT_DIR = "${HR_BUILD_OUTPUT_DIR}/build/u-boot"
```

## meta-rdk/conf/layer.conf
```bitbake
BBPATH .= ":${LAYERDIR}"

# We have recipes-* directories, add to BBFILES
BBFILES += "${LAYERDIR}/recipes-*/*/*.bb \
	    ${LAYERDIR}/recipes-*/*/*.bbappend"


BBFILE_COLLECTIONS += "rdk"
BBFILE_PATTERN_rdk := "^${LAYERDIR}/"

BBFILE_PRIORITY_rdk = "9"

RDKBASE = '${@os.path.normpath("${LAYERDIR}")}'
BB_BASEHASH_IGNORE_VARS:append = " RDKBASE"


LAYERSERIES_COMPAT_rdk = "scarthgap"
LAYERVERSION_rdk = "1.0"
LAYERDEPENDS_rdk = "core openembedded-layer"


RDK_SDK_DIR = "${TOPDIR}/../rdk-sdk"
RDK_SDK_UBOOT_DIR = "${RDK_SDK_DIR}/platform_source_code/uboot"

export RDK_SDK_DIR
export RDK_SDK_UBOOT_DIR
```

## meta-rdk/conf/machine/horizon-x5-soc.conf
```bitbake
require conf/machine/include/arm/arch-armv8-2a.inc

PREFERRED_PROVIDER_virtual/kernel = "linux"
KERNEL_IMAGETYPE = "Image"
KBUILD_DEFCONFIG := "hobot_x5_soc_defconfig"

PREFERRED_PROVIDER_virtual/bootloader = "u-boot-rdk"
UBOOT_MACHINE = "hobot_x5_auto_defconfig"

EXTERNAL_TOOLCHAIN = "/opt/arm-gnu-toolchain-11.3.rel1-x86_64-aarch64-none-linux-gnu"

TOOLCHAIN_PREFIX = "aarch64-none-linux-gnu-"

TARGET_CC = "${TOOLCHAIN_PREFIX}gcc"
TARGET_CXX = "${TOOLCHAIN_PREFIX}g++"
TARGET_AS = "${TOOLCHAIN_PREFIX}as"
TARGET_LD = "${TOOLCHAIN_PREFIX}ld"
TARGET_CPP = "${TOOLCHAIN_PREFIX}cpp"
TARGET_AR = "${TOOLCHAIN_PREFIX}ar"
TARGET_RANLIB = "${TOOLCHAIN_PREFIX}ranlib"
TARGET_OBJCOPY = "${TOOLCHAIN_PREFIX}objcopy"
TARGET_OBJDUMP = "${TOOLCHAIN_PREFIX}objdump"
TARGET_STRIP = "${TOOLCHAIN_PREFIX}strip"
TARGET_NM = "${TOOLCHAIN_PREFIX}nm"

BUILD_CC = "gcc"
BUILD_CXX = "g++"
BUILD_AS = "as"
BUILD_LD = "ld"

RDK_SDK_DIR = "${TOPDIR}/../rdk-sdk"
RDK_SDK_UBOOT_DIR = "${RDK_SDK_DIR}/platform_source_code/uboot"
```

## templates/conf/local.conf
```bitbake
MACHINE ??= "horizon-x5-soc"
DISTRO ?= "poky"
USER_CLASSES ?= "buildstats"
PATCHRESOLVE = "noop"
BB_DISKMON_DIRS ??= "\
    STOPTASKS,${TMPDIR},1G,100K \
    STOPTASKS,${DL_DIR},1G,100K \
    STOPTASKS,${SSTATE_DIR},1G,100K \
    STOPTASKS,/tmp,100M,100K \
    HALT,${TMPDIR},100M,1K \
    HALT,${DL_DIR},100M,1K \
    HALT,${SSTATE_DIR},100M,1K \
    HALT,/tmp,10M,1K"

PACKAGECONFIG:append:pn-qemu-system-native = " sdl"
CONF_VERSION = "2"

EXTERNAL_TOOLCHAIN = "/opt/arm-gnu-toolchain-11.3.rel1-x86_64-aarch64-none-linux-gnu"
export PATH := "${EXTERNAL_TOOLCHAIN}/bin:${PATH}"

TOOLCHAIN_PREFIX = "aarch64-none-linux-gnu-"

TARGET_CC = "${TOOLCHAIN_PREFIX}gcc"
TARGET_CXX = "${TOOLCHAIN_PREFIX}g++"
TARGET_AS = "${TOOLCHAIN_PREFIX}as"
TARGET_LD = "${TOOLCHAIN_PREFIX}ld"
TARGET_CPP = "${TOOLCHAIN_PREFIX}cpp"
TARGET_AR = "${TOOLCHAIN_PREFIX}ar"
TARGET_RANLIB = "${TOOLCHAIN_PREFIX}ranlib"
TARGET_OBJCOPY = "${TOOLCHAIN_PREFIX}objcopy"
TARGET_OBJDUMP = "${TOOLCHAIN_PREFIX}objdump"
TARGET_STRIP = "${TOOLCHAIN_PREFIX}strip"
TARGET_NM = "${TOOLCHAIN_PREFIX}nm"

BUILD_CC = "gcc"
BUILD_CXX = "g++"
BUILD_AS = "as"
BUILD_LD = "ld"
```
